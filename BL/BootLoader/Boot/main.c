#define F_CPU 8000000UL

#include <avr/io.h>
#include <util/delay.h>
#include <avr/interrupt.h>
#include <avr/boot.h>
#include <string.h>
#include <stdlib.h>
#include "UART.h"
#include "LCD.h"

// This array contains the binary code of the LED (on PB5) fast blinking program
// program size: 162 bytes
uint8_t program_bin[914]= {
  0x45, 0xc0, 0x00, 0x00, 0x60, 0xc0, 0x00, 0x00, 0x5e, 0xc0, 0x00, 0x00,
  0x5c, 0xc0, 0x00, 0x00, 0x5a, 0xc0, 0x00, 0x00, 0x58, 0xc0, 0x00, 0x00,
  0x56, 0xc0, 0x00, 0x00, 0x54, 0xc0, 0x00, 0x00, 0x52, 0xc0, 0x00, 0x00,
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  0x32, 0x00
  };
/**********************************************************************************************/
#define PAGESIZE 128 
#define BLINKY_PROGRAM_SIZE_IN_BYTES sizeof(program_bin)
#define BLINKY_PROGRAM_NUMBER_OF_PAGES ((BLINKY_PROGRAM_SIZE_IN_BYTES / PAGESIZE) + ((BLINKY_PROGRAM_SIZE_IN_BYTES % PAGESIZE == 0) ? 0 : 1))

 void write_program_pages(uint32_t first_page_address, uint8_t *program_buffer)
 {
	  uint16_t b;
	  uint16_t p;
	  uint16_t current_page_size;
	  uint32_t current_page_address;
	  uint8_t sreg_last_state;

	  // Disable interrupts.
	  sreg_last_state = SREG;
	  cli();

	  eeprom_busy_wait();

	  for (p = 0; p < BLINKY_PROGRAM_NUMBER_OF_PAGES; p++)
	  {
		  // Calculate current page size in bytes
		  if (p == BLINKY_PROGRAM_NUMBER_OF_PAGES - 1)
		  {
			  // Last page size
			  current_page_size = BLINKY_PROGRAM_SIZE_IN_BYTES -PAGESIZE * (BLINKY_PROGRAM_NUMBER_OF_PAGES - 1);
		  }
		  else
		  {
			  // Other page sizes
			  current_page_size = PAGESIZE;
		  }

		  current_page_address = first_page_address + p * PAGESIZE;

		  boot_page_erase(current_page_address);
		  boot_spm_busy_wait(); // Wait until the memory is erased.

		  for (b = 0; b < current_page_size; b += 2)
		  {
			  // Set up little-endian word
			  uint16_t w = *program_buffer++;
			  w += (*program_buffer++) << 8;

			  boot_page_fill(current_page_address + b, w);
		  }

		  boot_page_write(current_page_address); // Store buffer in flash page.
		  boot_spm_busy_wait();                  // Wait until the memory is written.
	  }

	  // Re-enable RWW-section again. We need this if we want to jump back
	  // to the application after bootloading.
	  boot_rww_enable();

	  // Re-enable interrupts (if they were ever enabled).
	  SREG = sreg_last_state;
  }

/*****************************************************************************************************/
uint16_t nn=0; char str[5]="";
void write_program_pages_fota(uint32_t first_page_address,uint16_t LEN)
{
	uint16_t page_size =128,pos=0 , num_pages= ((LEN /  page_size) + ((LEN %  page_size == 0) ? 0 : 1));
	uint16_t b;
	uint16_t p;
	uint16_t current_page_size;
	uint32_t current_page_address;
	uint8_t sreg_last_state;
	char L_Byte, H_Byte; 
	// Disable interrupts.
	sreg_last_state = SREG;
	cli();

	eeprom_busy_wait();

	for (p = 0; p <num_pages; p++)
	{
		// Calculate current page size in bytes
		if (p ==num_pages - 1)
		{
			// Last page size
			current_page_size =LEN - page_size * (num_pages - 1);
		}
		else
		{
			// Other page sizes
			current_page_size = page_size;
		}

		current_page_address = first_page_address + p * page_size;

		boot_page_erase(current_page_address);
		boot_spm_busy_wait(); // Wait until the memory is erased.

		for (b = 0; b < current_page_size; b += 2)
		{
			if (LEN%2==0)
			{
				L_Byte=USART_Receive();
				nn++;
				H_Byte=USART_Receive();
				nn++;
			}
			else
			{
				if (pos==(LEN-1))
				{
					L_Byte=USART_Receive();
					nn++;
					H_Byte=0xff;
					nn++;
				}
				else
				{
					L_Byte=USART_Receive();
					nn++;
					H_Byte=USART_Receive();	
					nn++;
				}
			}
			//sprintf(str ,"%d",nn);
			//LCD_Clear();
		    //_delay_ms(4);
			//LCD_String(str);
			USART_Transmit1(L_Byte);
			USART_Transmit1('\r');
			USART_Transmit1(H_Byte);
			USART_Transmit1('\r');
			
			// Set up little-endian word
			uint16_t w = L_Byte;
			w += (H_Byte) << 8;

			boot_page_fill(current_page_address + b, w);
		}

		boot_page_write(current_page_address); // Store buffer in flash page.
		boot_spm_busy_wait();                  // Wait until the memory is written.
	}

	// Re-enable RWW-section again. We need this if we want to jump back
	// to the application after bootloading.
	boot_rww_enable();

	// Re-enable interrupts (if they were ever enabled).
	SREG = sreg_last_state;
}

/*****************************************************************************************/

int main(void)
{
	LCD_Init();

	USART_Init( BAUD_PRESCALE);   //Initialise the USART 0 ; 

	DDRA = (1 << PA0);  // Configure LED PA0 as output
	//eeprom_update_byte ((uint8_t *)6, '0' );
	
	/**************************************************************************/	
		if ( eeprom_read_byte ((uint8_t*)0x10)==255)
		{  
			LCD_String("  Firmware V0.0");
			LCD_String_xy(1,3,"Loaded Now");
			_delay_ms(3000);
			 
			// Blink LED 10 times slowly to show that the bootloader program is starting
			for(int a=0 ; a<10 ; a++)
			{
				PORTA |= 1 << PA0; // Turn-on LED
				_delay_ms(500);
				PORTA &= ~(1 << PA0); // Turn-off LED
				_delay_ms(500);
			}
			
			eeprom_update_byte ((uint8_t *)0x10,0); 
			
			write_program_pages(0x00000,  program_bin);
			
			LCD_Clear();  _delay_ms(10); 
				
			LCD_String("Firmware Loaded");
			
			LCD_String_xy(1,2,"Successfully");
			
			_delay_ms(3000);
			
			LCD_Clear();
			
			asm("jmp 0");
		}
		/*******************************************************************************/
		if ( eeprom_read_byte ((uint8_t *)6)=='F')
		{
			eeprom_update_byte ((uint8_t *)6, '0'); _delay_ms(10);
			LCD_Clear();  _delay_ms(10);
			LCD_String("FOTA Process");  UART_SendString1("New Firmware is Loaded Now : \r\n");
			 _delay_ms(2000);
			USART_Transmit('S');
			write_program_pages_fota(0,eeprom_read_word ((uint16_t *)4));
			LCD_Clear();
			_delay_ms(100);
			LCD_String("Firmware Updated");
			LCD_String_xy(1,2,"Successfully");
			_delay_ms(2000);
			LCD_Clear();
			asm("jmp 0");
		}
		_delay_ms(1000);
		asm("jmp 0");
		
	
}
